## projekti_koodi/nrf5340_koodi/build/Kconfig/Kconfig.shield
```kconfig
osource "c:/koulu/syksy23/tietoliikenne_sovellusprojekti/tl_projekti/projekti_koodi/nrf5340_koodi/boards/shields/*/Kconfig.shield"
osource "C:/ncs/v2.5.0/nrf/boards/shields/*/Kconfig.shield"
```

## projekti_koodi/nrf5340_koodi/build/Kconfig/Kconfig.shield.defconfig
```kconfig
osource "c:/koulu/syksy23/tietoliikenne_sovellusprojekti/tl_projekti/projekti_koodi/nrf5340_koodi/boards/shields/*/Kconfig.defconfig"
osource "C:/ncs/v2.5.0/nrf/boards/shields/*/Kconfig.defconfig"
```
